## meta-nvidia/conf/machine/include/nvidia.inc
```bitbake
OBMC_IMAGE_EXTRA_INSTALL:append = " \
    nvidia-gpuoob \
    nvidia-gpumgr \
    "

OBMC_ORG_YAML_SUBDIRS += " com/nvidia "
```

## meta-nvidia/meta-prime/conf/layer.conf
```bitbake
# We have a conf and classes directory, add to BBPATH
BBPATH .= ":${LAYERDIR}"

# We have recipes-* directories, add to BBFILES
BBFILES += "${LAYERDIR}/recipes-*/*/*.bb \
            ${LAYERDIR}/recipes-*/*/*.bbappend \
            ${LAYERDIR}/recipes-*/*/*/*.bbappend \
            "

BBFILE_COLLECTIONS += "nvidia-prime-layer"
BBFILE_PATTERN_nvidia-prime-layer := "^${LAYERDIR}/"
LAYERSERIES_COMPAT_nvidia-prime-layer = "nanbield scarthgap"

# Provide a variable that points the base of the NVIDIA layer
NVIDIABASE = '${@os.path.normpath("${LAYERDIR}/")}'
CONNECTIVITY_CHECK_URIS = "https://www.google.com"
```

## meta-nvidia/meta-prime/meta-gb200nvl/meta-bmc/conf/machine/gb200nvl-bmc.conf
```bitbake
KERNEL_DEVICETREE = "aspeed-bmc-nvidia-gb200nvl-bmc.dtb"

UBOOT_MACHINE = "ast2600_openbmc_spl_defconfig"
UBOOT_DEVICETREE = "ast2600-gb200nvl-bmc-nvidia"
SPL_BINARY = "spl/u-boot-spl.bin"

# Manipulate the DISTRO_NAME variable string for our needs
DISTRO_NAME:remove = "Phosphor"
DISTRO_NAME:remove = "OpenBMC"
DISTRO_NAME:remove = "(Phosphor"
DISTRO_NAME:prepend = "NVIDIA Host BMC (OpenBMC "


# Declare offsets (in KB) of each flash partition
FLASH_UBOOT_OFFSET = "0"
FLASH_UBOOT_ENV_OFFSET = "896"
FLASH_KERNEL_OFFSET = "1024"
FLASH_ROFS_OFFSET = "10240"
FLASH_RWFS_OFFSET:flash-65536 = "65532"

SOCSEC_SIGN_ENABLE = "0"

# E4830-BMC has 64MB spi flash
FLASH_SIZE = "65536"

# E4830-BMC has 64MB - 4K image size; the last 4K section is for image signature
# metadata
IMAGE_SIZE_ACTUAL = "65532"

require conf/machine/include/ast2600.inc

SERIAL_CONSOLES = "115200;ttyS4"

VIRTUAL-RUNTIME_obmc-inventory-manager = "entity-manager"
#VIRTUAL-RUNTIME_obmc-inventory-manager = "nvidia-gpumgr"
PREFERRED_PROVIDER_virtual/obmc-inventory-data = "entity-manager"
#PREFERRED_PROVIDER_virtual/obmc-inventory-data = "nvidia-gpumgr"
PREFERRED_PROVIDER_virtual/phosphor-led-manager-config-native = "led-manager-config-native"

# Install Kernel modules
MACHINE_EXTRA_RRECOMMENDS = "kernel-modules"

# Remove default OpenBMC features we don't need
DISTRO_FEATURES:remove = "avahi"
IMAGE_FEATURES:remove = "obmc-phosphor-power"
IMAGE_FEATURES:remove = "phosphor-snmp"

IMAGE_INSTALL:append = "mmc-utils systemd-analyze"

# this is needed by emmc, avoid removing it.
BAD_RECOMMENDATIONS:remove = "e2fsprogs-e2fsck"
```

## meta-nvidia/meta-prime/meta-graceblackwell/meta-gb200nvl/meta-bmc/meta-bmc-dgx/conf/layer.conf
```bitbake
# We have a conf and classes directory, add to BBPATH
BBPATH .= ":${LAYERDIR}"

# We have recipes-* directories, add to BBFILES
BBFILES += "${LAYERDIR}/recipes-*/*/*.bb \
            ${LAYERDIR}/recipes-*/*/*.bbappend \
            ${LAYERDIR}/recipes-*/*/*/*.bbappend \
	   "

BBFILE_COLLECTIONS += "nvidia-gb200nvl-bmc-dgx-layer"
BBFILE_PATTERN_nvidia-gb200nvl-bmc-dgx-layer = "^${LAYERDIR}/"

LAYERSERIES_COMPAT_nvidia-gb200nvl-bmc-dgx-layer = "nanbield scarthgap"
```

## meta-nvidia/meta-prime/meta-graceblackwell/meta-gb200nvl/meta-hmc/conf/machine/gb200nvl-hmc.conf
```bitbake
KERNEL_DEVICETREE = "aspeed-bmc-nvidia-gb200nvl-hmc.dtb"

UBOOT_MACHINE = "ast2600_openbmc_spl_defconfig"
UBOOT_DEVICETREE = "ast2600-gb200nvl-hmc-nvidia"
SPL_BINARY = "spl/u-boot-spl.bin"

# Forces OTP provisioning image to use the prod configuration
OTP_KEY_TYPE ?= "prod"

# Manipulate the DISTRO_NAME variable string for our needs
DISTRO_NAME:remove = "Phosphor"
DISTRO_NAME:remove = "OpenBMC"
DISTRO_NAME:remove = "(Phosphor"
DISTRO_NAME:prepend = "NVIDIA Host BMC (OpenBMC "


# Declare offsets (in KB) of each flash partition
FLASH_UBOOT_OFFSET = "0"
FLASH_UBOOT_ENV_OFFSET = "896"
FLASH_KERNEL_OFFSET = "1024"
FLASH_ROFS_OFFSET = "10240"
#FLASH_RWFS_OFFSET:flash-65536 = "${@bb.utils.contains('DISTRO_FEATURES', 'otp-provisioning', '54296', '54000', d)}"
FLASH_RWFS_OFFSET:flash-65536 = "${@bb.utils.contains('DISTRO_FEATURES', 'otp-provisioning', '55296', '54000', d)}"

SOCSEC_SIGN_ENABLE = "0"

# E4830-BMC has 64MB spi flash
FLASH_SIZE = "65536"

# E4830-BMC has 64MB - 4K image size; the last 4K section is for image signature
# metadata
IMAGE_SIZE_ACTUAL = "65532"

require conf/machine/include/ast2600.inc

SERIAL_CONSOLES = "115200;ttyS4"
IMAGE_INSTALL:append = "pciutils mmc-utils systemd-analyze iperf3 ethtool phytool usbutils tcpdump"

VIRTUAL-RUNTIME_obmc-inventory-manager = "entity-manager"
#VIRTUAL-RUNTIME_obmc-inventory-manager = "nvidia-gpumgr"
PREFERRED_PROVIDER_virtual/obmc-inventory-data = "entity-manager"
#PREFERRED_PROVIDER_virtual/obmc-inventory-data = "nvidia-gpumgr"

# Install Kernel modules
MACHINE_EXTRA_RRECOMMENDS = "kernel-modules"

# Remove default OpenBMC features that don't apply
DISTRO_FEATURES:remove = "avahi"
DISTRO_FEATURES:remove = "obmc-host-ipmi"
DISTRO_FEATURES:remove = "obmc-phosphor-fan-mgmt"
DISTRO_FEATURES_OBMC:remove = "obmc-host-ipmi"
DISTRO_FEATURES_OBMC:remove = "obmc-phosphor-fan-mgmt"
PACKAGE_EXCLUDE += " nvidia-ipmi-oem"
PACKAGE_EXCLUDE += " obmc-host-ipmi"
IMAGE_FEATURES:remove = "nvidia-ipmi-oem"
IMAGE_FEATURES:remove = "obmc-console"
IMAGE_FEATURES:remove = "obmc-ikvm"
IMAGE_FEATURES:remove = "obmc-phosphor-power"
IMAGE_FEATURES:remove = "obmc-dbus-monitor"
IMAGE_FEATURES:remove = "obmc-fan-mgmt"
IMAGE_FEATURES:remove = "obmc-fan-control"
IMAGE_FEATURES:remove = "obmc-health-monitor"
IMAGE_FEATURES:remove = "obmc-leds"
IMAGE_FEATURES:remove = "phosphor-snmp"
IMAGE_FEATURES:remove = "obmc-watchdog"
IMAGE_FEATURES:remove = "slpd-lite"
IMAGE_FEATURES:remove = "obmc-user-mgmt-ldap"

# NOTE: IPMI should be removed from the HMC build
# This will cause a build error if it gets pulled in
# as a dependency to ensure it's not added by mistake
VIRTUAL-RUNTIME_phosphor-ipmi-providers=""

# this is needed by emmc, avoid removing it.
BAD_RECOMMENDATIONS:remove = "e2fsprogs-e2fsck"

# Build type, valid values are debug, dev and prod (production)
# Affects how signing is done and what keys are used and is included
# in the names of resulting images
#  BUILD_TYPE="prod" : The firmware is signed with production keys and no development tools enabled.
#  BUILD_TYPE="debug": The firmware is signed with debug keys and no development tools enabled.
#  BUILD_TYPE="dev": The firmware includes debug tools enabled for the development and signed with debug keys.
BUILD_TYPE ?= "dev"
```

## meta-nvidia/meta-prime/meta-graceblackwell/meta-pcie-gpu/conf/layer.conf
```bitbake
# We have a conf and classes directory, add to BBPATH
BBPATH .= ":${LAYERDIR}"

# We have recipes-* directories, add to BBFILES
BBFILES += "${LAYERDIR}/recipes-*/*/*.bb \
            ${LAYERDIR}/recipes-*/*/*.bbappend \
            ${LAYERDIR}/recipes-*/*/*/*.bbappend \
            "

BBFILE_COLLECTIONS += "nvidia-pcie-gpu-layer"
BBFILE_PATTERN_nvidia-pcie-gpu-layer := "^${LAYERDIR}/"
LAYERSERIES_COMPAT_nvidia-pcie-gpu-layer = "nanbield scarthgap"

# Provide a variable that points the base of the NVIDIA layer
NVIDIABASE = '${@os.path.normpath("${LAYERDIR}/")}'
CONNECTIVITY_CHECK_URIS = "https://www.google.com"
```

## meta-nvidia/meta-prime/meta-graceblackwell/meta-pcie-gpu/meta-bmc/conf/layer.conf
```bitbake
# We have a conf and classes directory, add to BBPATH
BBPATH .= ":${LAYERDIR}"

# We have recipes-* directories, add to BBFILES
BBFILES += "${LAYERDIR}/recipes-*/*/*.bb \
            ${LAYERDIR}/recipes-*/*/*.bbappend \
            ${LAYERDIR}/recipes-*/*/*/*.bbappend \
	   "

BBFILE_COLLECTIONS += "nvidia-pcie-gpu-bmc-layer"
BBFILE_PATTERN_nvidia-pcie-gpu-bmc-layer = "^${LAYERDIR}/"

LAYERSERIES_COMPAT_nvidia-pcie-gpu-bmc-layer = "nanbield scarthgap"
```
