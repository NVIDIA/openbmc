## meta-axiado/meta-nvidia/conf/layer.conf
```bitbake
# We have a conf and classes directory, add to BBPATH
BBPATH .= ":${LAYERDIR}"

# We have recipes-* directories, add to BBFILES
BBFILES += "${LAYERDIR}/recipes-*/*/*.bb \
            ${LAYERDIR}/recipes-*/*/*.bbappend \
            "

BBFILE_COLLECTIONS += "ax-nvidia-layer"
BBFILE_PATTERN_ax-nvidia-layer := "^${LAYERDIR}/"
LAYERSERIES_COMPAT_ax-nvidia-layer = "scarthgap styhead"

# Mask all of Aspeed-related recipes because Nvidia build with Aspeed SoC by default
BBMASK += "/meta-nvidia/recipes-aspeed/aspeed-app/aspeed-app_%.bbappend"
BBMASK += "/meta-nvidia/recipes-aspeed/socsec/socsec_%.bbappend"
BBMASK += "/meta-nvidia/meta-prime/recipes-kernel/linux/linux-aspeed_%.bbappend"
BBMASK += "/meta-nvidia/meta-prime/meta-graceblackwell/recipes-bsp/u-boot/u-boot-aspeed-sdk_%.bbappend"
BBMASK += "/meta-nvidia/meta-prime/meta-graceblackwell/recipes-bsp/u-boot/u-boot-fw-utils-aspeed-sdk_%.bbappend"
BBMASK += "/meta-nvidia/meta-prime/meta-graceblackwell/recipes-kernel/linux/linux-aspeed_%.bbappend"
BBMASK += "/meta-nvidia/meta-prime/meta-graceblackwell/meta-gb200nvl/meta-bmc/recipes-bsp/u-boot/u-boot-aspeed-sdk_%.bbappend"
BBMASK += "/meta-nvidia/meta-prime/meta-graceblackwell/meta-gb200nvl/meta-bmc/recipes-kernel/linux/linux-aspeed_%.bbappend"
```
